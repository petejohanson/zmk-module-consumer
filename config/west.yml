## config/west.yml
```yaml
manifest:
  remotes:
    - name: zmkfirmware
      url-base: https://github.com/zmkfirmware
    - name: petejohanson
      url-base: https://github.com/petejohanson
  projects:
    - name: zmk-module-test
      remote: petejohanson
      revision: main
    - name: zmk
      remote: petejohanson
      revision: core/modular-build-exploration
      import: app/west.yml
  self:
    path: config
```
