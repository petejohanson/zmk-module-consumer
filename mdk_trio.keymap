/*
 * Copyright (c) 2020 Pete Johanson, Richard Jones
 *
 * SPDX-License-Identifier: MIT
 */

#include <behaviors.dtsi>
#include <dt-bindings/zmk/keys.h>
#include <dt-bindings/zmk/bt.h>
#include <dt-bindings/zmk/outputs.h>

/ {
    chosen {
        zmk,keymap = &user_keymap;
    };

    user_keymap: keymap {
        compatible = "zmk,keymap";

        default_layer {
            bindings = <
	    &out OUT_TOG &bt BT_CLR &kp LS(NUM_1)
	    /*
	    &kp K_APP &kp K_MENU &cp C_MENU
	    */
	    >;
        };
    };
};


